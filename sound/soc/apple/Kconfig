## sound/soc/apple/Kconfig
```kconfig
# SPDX-License-Identifier: GPL-2.0-only
menu "Apple"

config SND_SOC_APPLE_AOP_AUDIO
	tristate "AOP audio driver"
	depends on ARCH_APPLE || COMPILE_TEST
	depends on INPUT
	depends on RUST
	select APPLE_AOP
	select SND_DMAENGINE_PCM
	help
	  This option enables an ASoC driver for sound devices connected to the AOP
	  co-processor on ARM Macs. This includes the built-in microphone on those
	  machines, and on T8140 the back-end DAIs for the headphone jack and the
	  internal speaker, which the macaudio driver links into its card.

config SND_SOC_APPLE_MCA
	tristate "Apple Silicon MCA driver"
	depends on ARCH_APPLE || COMPILE_TEST
	select SND_DMAENGINE_PCM
	help
	  This option enables an ASoC platform driver for MCA peripherals found
	  on Apple Silicon SoCs.

config SND_SOC_APPLE_MACAUDIO
	tristate "Sound support for Apple Silicon Macs"
	depends on ARCH_APPLE || COMPILE_TEST
	select SND_SOC_APPLE_MCA
	select SND_SIMPLE_CARD_UTILS
	select APPLE_ADMAC if DMADEVICES
	select COMMON_CLK_APPLE_NCO if COMMON_CLK
	select SND_SOC_TAS2764 if I2C
	select SND_SOC_TAS2770 if I2C
	select SND_SOC_CS42L83 if I2C
	select SND_SOC_CS42L84 if I2C
	select SND_SOC_MAX98357A
	select REGULATOR_FIXED_VOLTAGE if REGULATOR
	help
	  This option enables an ASoC machine-level driver for Apple Silicon Macs
	  and it also enables the required SoC and codec drivers for overall
	  sound support on these machines.

config SND_SOC_APPLE_T8132_SPEAKER
	tristate "Mac mini (M4, J773g) internal speaker (EXPERIMENTAL)"
	depends on ARCH_APPLE && ARM64_16K_PAGES && I2C && GPIOLIB && OF
	depends on DMADEVICES
	select SND_PCM
	select SND_SOC_APPLE_MCA
	select SND_SOC_TAS2764
	select APPLE_ADMAC
	help
	  Mono internal-speaker playback for the Mac mini (M4, 2024, J773g):
	  MCA cluster 0 (TX0) on the T8132 drives the SN012776 (TAS2764
	  family) amplifier on I2C3. Playback is fixed at 48 kHz, mono,
	  S24_LE, and the card is named "T8132Speaker".

	  WARNING: speaker protection is done by an in-kernel voice-coil
	  thermal model, not by speakersafetyd and not by the amplifier's
	  V/I sense feedback. Samples are attenuated, and their energy charged
	  to the model, before they reach the DMA ring; the amplifier is held
	  at a hardware volume ceiling (module parameter ceiling_dvc, default
	  20 = -10 dB). The model's thermal constants come from the J773g
	  macOS preset, but the electrical parameters (full_scale_mv,
	  resistance_mohm, power_margin_pct) are unmeasured assumptions and
	  the limiter has not been validated against real voice-coil
	  temperatures. Loud, sustained playback may damage the speaker.
	  Do not raise the ceiling.

	  The driver binds only to an "apple,j773g-speaker" device tree node.
	  It is off by default: enable it only if you accept that risk. To
	  build it as a module, choose M here: the module will be called
	  snd-t8132-speaker. Blacklisting that module disables the speaker.

endmenu
```
